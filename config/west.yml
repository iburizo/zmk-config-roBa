## config/west.yml
```yaml
manifest:
  remotes:
    - name: zmkfirmware
      url-base: https://github.com/zmkfirmware
      # JIS-US変換でこれにしないといけなかった
    - name: kot149
      url-base: https://github.com/kot149
  # マウスカーソル加速度変更用に使っていた
    - name: kumamuk-git
      url-base: https://github.com/kumamuk-git
#マウスカーソル加速度変更のため、マウス用ドライバを別の人のものに変更
#    - name: sayu-hub
#      url-base: https://github.com/sayu-hub
  projects:
    - name: zmk
      remote: zmkfirmware
      revision: v0.3-branch
      import: app/west.yml
      # JIS-US変換用にパッチ追加
    - name: zmk-layout-shift
      remote: kot149
      revision: v1
    - name: zmk-pmw3610-driver
      remote: kumamuk-git
      revision: main
  self:
    path: config
```
