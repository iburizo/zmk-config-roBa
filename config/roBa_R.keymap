#include "roBa_L.keymap"

#include "boards/shields/Test/roBa_R.overlay"
&trackball {
    // automouse-layer = <MOUSE>;
    scroll-layers = <3>;
    // snipe-layers = <5>;
    arrows {
        layers = <4>;
        bindings =
            <&kp RIGHT_ARROW>,
            <&kp LEFT_ARROW>,
            <&kp UP_ARROW>,
            <&kp DOWN_ARROW>;

        tick = <30>;
        wait-ms = <5>;
        tap-ms = <5>;
    };

    volume {
        layers = <1>;
        bindings =
                <&none>,
                <&none>,
                <&kp C_VOLUME_UP>,
                <&kp C_VOLUME_DOWN>;

        wait-ms = <5>;
        tap-ms = <5>;
    };
};
